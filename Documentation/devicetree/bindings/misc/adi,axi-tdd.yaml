## Documentation/devicetree/bindings/misc/adi,axi-tdd.yaml
```yaml
# SPDX-License-Identifier: (GPL-2.0-only OR BSD-2-Clause)
# Copyright 2023 Analog Devices Inc.
%YAML 1.2
---
$id: http://devicetree.org/schemas/misc/adi,axi-tdd.yaml#
$schema: http://devicetree.org/meta-schemas/core.yaml#

title: Analog Devices AXI TDD Core

maintainers:
  - David Winter <david.winter@analog.com>
  - Eliza Balas <eliza.balas@analog.com>

description: |
  Bindings for the new generic TDD CORE, which is part of the Analog Devices hdl reference designs.
  For more information see the wiki: https://wiki.analog.com/resources/fpga/docs/axi_tdd

properties:
  compatible:
    enum:
      - adi,axi-tdd-2.00.a

  reg:
    maxItems: 1

  clocks:
    items:
      - description: System clock
      - description: TDD Core clock

  clock-names:
    items:
      - const: s_axi_aclk
      - const: intf_clk

required:
  - compatible
  - reg
  - clocks
  - clock-names

unevaluatedProperties: false

examples:
  - |
    tdd: tdd@84a00000 {
            compatible = "adi,axi-tdd-2.00.a";
            reg = <0x84a00000 0x10000>;
            clocks = <&zynqmp_clk_PL0_REF>, <&zynqmp_clk_PL1_REF>;
            clock-names = "s_axi_aclk", "intf_clk";
    };
...
```
